## base_external/Config.in
```kconfig
source "$BR2_EXTERNAL_assignment_base_PATH/package/LCD/Config.in"
source "$BR2_EXTERNAL_assignment_base_PATH/package/VL6180X/Config.in"
source "$BR2_EXTERNAL_assignment_base_PATH/package/LCD-char-driver/Config.in"
```

## base_external/package/LCD-char-driver/Config.in
```kconfig
config BR2_PACKAGE_LCD_CHAR_DRIVER
	bool "LCD-char-driver"
	help
	  LCD char device driver, includes load and unload scripts
```

## base_external/package/VL6180X/Config.in
```kconfig
config BR2_PACKAGE_VL6180X
	bool "VL6180X"
	help
	  Add VL6180x program to read LUX values
```
